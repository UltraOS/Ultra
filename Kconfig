## Kconfig
```kconfig
mainmenu "Ultra Kernel Configuration"

# Enable tristate support unconditionally
config MODULES
    bool
    option modules
    default y

source "kernel/Kconfig"
```

## kernel/Kconfig
```kconfig
choice
    prompt "Target CPU architecture"
    default ARCH_X86_64

    config ARCH_X86_64
        bool "x86_64"
        select ARCH_X86_64_BASE

    config ARCH_AARCH64
        bool "aarch64"
        select ARCH_AARCH64_BASE
endchoice

menu "Kernel build options"

choice
    prompt "Toolchain to use"
    default TOOLCHAIN_CLANG

    config TOOLCHAIN_CLANG
        bool "clang"

    config TOOLCHAIN_GCC
        bool "GCC"
endchoice

config TOOLCHAIN_STRING
    string
    default "clang" if TOOLCHAIN_CLANG
    default "gcc" if TOOLCHAIN_GCC

config OPTIMIZATION_LEVEL
    int "Optimization level to build the kernel with"
    default 0
    range 0 3

config LTO
    bool "Enable Link-Time Optimization"
    default n

endmenu

config CPU_MASK_OUT_OF_LINE
    bool
    help
        Store the contents of a cpu_mask_handle on the heap instead
        of inline within the handle itself. Out-of-line masks are
        sized by the number of CPUs detected at boot rather than the
        compile-time maximum, and every mask operation is bounded by
        that count. Intended to be selected by configurations with a
        MAX_CPUS large enough that inline masks are too big to live
        on the stack.

menu "Debug options"

config VERBOSE_INIT_LEVELS
    bool "Trace all kernel initialization level transitions"

config DEBUG_MM
    bool "Enable debug assertions for the memory management subsystem"

menuconfig UBSAN
    bool "Undefined behavior sanitizer"
    depends on ARCH_HAS_UBSAN

if UBSAN

config UBSAN_BOUNDS
    bool "Check array indices against their statically known bounds"
    default y

config UBSAN_SHIFT
    bool "Check for shifts that are out of range"
    default y

config UBSAN_SIGNED_OVERFLOW
    bool "Check for signed integer overflow"
    default y

config UBSAN_DIV_ZERO
    bool "Check for integer division by zero"
    depends on TOOLCHAIN_GCC

config UBSAN_UNREACHABLE
    bool "Check for control flow reaching __builtin_unreachable()"
    default y

config UBSAN_BOOL
    bool "Check for loads of bool values that are neither 0 nor 1"
    default y

endif

endmenu

rsource "arch/Kconfig"
rsource "irq/Kconfig"
rsource "drivers/Kconfig"
```

## kernel/arch/Kconfig
```kconfig
# Arch endianess settings
config ARCH_LITTLE_ENDIAN
    bool

config ARCH_BIG_ENDIAN
    bool

# Arch bitness settings
config ARCH_64BIT
    bool

config ARCH_32BIT
    bool

config ARCH_WIDTH
    int
    default 8 if ARCH_64BIT
    default 4 if ARCH_32BIT

config ARCH_FORCE_64BIT_PHYS_ADDR_WIDTH
    def_bool n

config ARCH_PHYS_ADDR_WIDTH
    int
    default 8 if (ARCH_64BIT || ARCH_FORCE_64BIT_PHYS_ADDR_WIDTH)
    default 4 if ARCH_32BIT

config ARCH_HAS_UBSAN
    bool

config ARCH_HAS_PAGE_SIZE_4K
    bool

choice
    prompt "Page size"

    config PAGE_SIZE_4K
        bool "4KiB"
        depends on ARCH_HAS_PAGE_SIZE_4K
endchoice

config PAGE_SHIFT
    int
    default 12 if PAGE_SIZE_4K

# Declared here so the symbol always exists as an int. An arch with
# a different cache line size gives it a default of its own.
config ARCH_CACHE_LINE_SHIFT
    int

config CACHE_LINE_SHIFT
    int
    default ARCH_CACHE_LINE_SHIFT if ARCH_CACHE_LINE_SHIFT > 0
    default 6

if ARCH_X86_64
rsource "x86_64/Kconfig"
endif

if ARCH_AARCH64
rsource "aarch64/Kconfig"
endif
```

## kernel/arch/x86_64/Kconfig
```kconfig
config ARCH_STRING
    def_string "x86_64"

config MAX_CPUS
    int "Maximum number of usable CPUs"
    range 2 256
    default 256
    help
        Changing this number is only useful for reducing the kernel image size.
        The kernel is always configured to support SMP, so the minimum number
        of supported CPUs must be at least 2.

config ARCH_X86_64_BASE
    bool
    select ARCH_LITTLE_ENDIAN
    select ARCH_64BIT
    select ACPI
    select ACPI_PM
    select HPET

rsource "hypervisor/Kconfig"
```

## kernel/arch/x86_64/hypervisor/Kconfig
```kconfig
menuconfig PARAVIRT
    bool "Enable paravirtualization support"

if PARAVIRT

config KVM_GUEST
    bool "Support for running as a KVM guest"
    select PVCLOCK
    default y

config EMULATOR_GUEST
    bool "Support for Bochs and QEMU+TCG"
    default y

endif
```

## kernel/demo/Kconfig
```kconfig
menu "Demos"

config FIREWORKS_DEMO
    tristate "Fireworks scheduler stress demo"
    depends on !FLANTERM_CONSOLE
    help
        Draw fireworks on the framebuffer once the kernel is up, with
        one thread per rocket and per particle. Every thread plots its
        pixel, sleeps for a frame and moves on, so a volley keeps a
        few thousand threads sleeping and waking 60 times a second.
        Statistics go to the log every couple of seconds. It runs until
        the machine is turned off, or for fireworks.runtime-seconds=<n>
        from the kernel command line.

        The demo owns the framebuffer, which is why it cannot be
        combined with the framebuffer log console.

endmenu
```

## kernel/drivers/Kconfig
```kconfig
config SMBIOS
    bool

menu "Drivers"
rsource "time/Kconfig"
rsource "acpi/Kconfig"
rsource "console/Kconfig"
endmenu
```

## kernel/drivers/console/flanterm/Kconfig
```kconfig
config FLANTERM_CONSOLE
    bool "Enable flanterm-based framebuffer log console"
```

## kernel/drivers/time/Kconfig
```kconfig
config PVCLOCK
    depends on ARCH_X86_64 && PARAVIRT
    bool

config HPET
    depends on ACPI
    bool
```

## kernel/ktest/Kconfig
```kconfig
menuconfig KTEST
    bool "In-kernel integration tests"
    help
        A runner for tests that need the real kernel around them, e.g.
        interrupts, timers and threads on real hardware. Each test runs
        in its own thread with a timeout and the results are printed
        in KTAP format, ending in a summary line.

        Nothing runs unless the kernel command line has ktest.run=all.

if KTEST

config KTEST_ALL_TESTS
    bool "Build every test"
    default y
    help
        Turn off to pick the tests to build one by one.

config KTEST_SELFTEST
    bool "Tests of the test runner itself" if !KTEST_ALL_TESTS
    default KTEST_ALL_TESTS

endif
```

## kernel/locking/tests/Kconfig
```kconfig
config KTEST_MUTEX
    bool "Mutex tests" if !KTEST_ALL_TESTS
    default KTEST_ALL_TESTS
```

## kernel/memory/tests/Kconfig
```kconfig
config KTEST_MEMORY_DESCRIBE
    bool "Memory description tests" if !KTEST_ALL_TESTS
    default KTEST_ALL_TESTS
```

## kernel/sched/tests/Kconfig
```kconfig
config KTEST_SCHED
    bool "Scheduler tests" if !KTEST_ALL_TESTS
    default KTEST_ALL_TESTS
```

## kernel/time/tests/Kconfig
```kconfig
config KTEST_TIME
    bool "Timer and clock tests" if !KTEST_ALL_TESTS
    default KTEST_ALL_TESTS
```
